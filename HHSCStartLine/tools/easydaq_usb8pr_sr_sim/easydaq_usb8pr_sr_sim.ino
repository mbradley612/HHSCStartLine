/*
 * FULL Hardware Simulator for EasyDAQ USB8PR-SR Relay Card
 * Simplified version without EEPROM storage
 * Mimics ALL documented behaviors from the datasheet
 *
 * Generated by DeepSeek in response to:
 *
 * Can you write me an arduino sketch to simulate one of these
 * https://www.easydaq.co.uk/datasheets/Data%20Sheet%2019%20USB8PR-SR%20(USB%20connected%208%20Chan%20Power-Signal%20Relay%20card).pdf
 */

// ===== HARDWARE CONFIGURATION =====
const int NUM_RELAYS = 8;
const int RELAY_PINS[NUM_RELAYS] = {2, 3, 4, 5, 6, 7, 8, 9};  // Your LED connections
const int USB_LED_PIN = 13;  // Simulates USB connection LED (built-in LED)

// ===== RELAY TIMING CONSTANTS (from datasheet page 2) =====
const unsigned long RELAY_OPERATE_TIME = 10;    // ms (10ms operate time)
const unsigned long RELAY_RELEASE_TIME = 5;     // ms (5ms release time)

// ===== DEVICE STATE =====
byte relayState = 0;           // Current latched state (bits 0-7)
byte portBDirection = 0xFF;    // Port B direction (1=input, 0=output) - all inputs initially
unsigned long relayTimers[NUM_RELAYS];  // Track timing for each relay
bool relayTransitioning[NUM_RELAYS];    // Track if relay is in transition

// ===== COMMAND CONSTANTS =====
const char CMD_SET_DIR = 'B';          // 0x42
const char CMD_WRITE_DATA = 'C';       // 0x43

// ===== STATE MACHINE =====
enum ParserState {
  STATE_IDLE,
  STATE_GOT_COMMAND_B,
  STATE_GOT_COMMAND_C
};
ParserState parserState = STATE_IDLE;

// ===== SETUP =====
void setup() {
  // Initialize physical outputs
  for (int i = 0; i < NUM_RELAYS; i++) {
    pinMode(RELAY_PINS[i], OUTPUT);
    digitalWrite(RELAY_PINS[i], LOW);
    relayTimers[i] = 0;
    relayTransitioning[i] = false;
  }
  
  pinMode(USB_LED_PIN, OUTPUT);
  digitalWrite(USB_LED_PIN, HIGH);  // USB LED ON when connected
  
  // Initialize serial EXACTLY as the real device
  Serial.begin(9600, SERIAL_8N1);  // 9600 baud, 8 data bits, no parity, 1 stop bit
  while (!Serial) {
    ; // Wait for serial port to connect
  }
  
  // Device initialization message
  delay(50);  // Simulate brief device boot time
  Serial.println();
  Serial.println("USB8PR-SR Hardware Simulator");
  Serial.println("Protocol: 9600 8N1, No handshaking");
  Serial.println("Commands: B<byte> or C<byte>");
  Serial.println("Ready.");
}

// ===== MAIN LOOP =====
void loop() {
  // Process incoming serial commands
  processSerialCommands();
  
  // Update relay transitions (simulate operate/release timing)
  updateRelayTransitions();
}

// ===== SERIAL COMMAND PROCESSING =====
void processSerialCommands() {
  while (Serial.available() > 0) {
    byte incoming = Serial.read();
    
    switch (parserState) {
      case STATE_IDLE:
        if (incoming == CMD_SET_DIR || incoming == 0x42) {
          parserState = STATE_GOT_COMMAND_B;
        } 
        else if (incoming == CMD_WRITE_DATA || incoming == 0x43) {
          parserState = STATE_GOT_COMMAND_C;
        } 
        else {
          // Invalid command - real device ignores silently
          // For debugging, you can uncomment:
          // Serial.print("X"); // Indicates invalid command
        }
        break;
        
      case STATE_GOT_COMMAND_B:
        // Set Port B direction (from datasheet: 1=input, 0=output)
        portBDirection = incoming;
        // Real device stores this but doesn't use it (read function not available)
        parserState = STATE_IDLE;
        break;
        
      case STATE_GOT_COMMAND_C:
        // Write data to relays (latching, as per datasheet)
        byte previousState = relayState;
        relayState = incoming;  // Data is latched immediately
        
        // Start timing transitions for changed relays
        byte changed = previousState ^ relayState;
        for (int i = 0; i < NUM_RELAYS; i++) {
          if (bitRead(changed, i)) {
            relayTransitioning[i] = true;
            relayTimers[i] = millis();
          }
        }
        
        // Optional acknowledgment (real device doesn't acknowledge)
        // Uncomment for debugging:
        // Serial.print("OK:"); 
        // if (relayState < 0x10) Serial.print("0");
        // Serial.println(relayState, HEX);
        
        parserState = STATE_IDLE;
        break;
    }
  }
}

// ===== RELAY TIMING SIMULATION =====
void updateRelayTransitions() {
  for (int i = 0; i < NUM_RELAYS; i++) {
    if (relayTransitioning[i]) {
      unsigned long elapsed = millis() - relayTimers[i];
      bool targetState = bitRead(relayState, i);
      
      // Determine required delay based on transition direction
      unsigned long requiredDelay = targetState ? RELAY_OPERATE_TIME : RELAY_RELEASE_TIME;
      
      if (elapsed >= requiredDelay) {
        // Final state - update physical output
        digitalWrite(RELAY_PINS[i], targetState ? HIGH : LOW);
        relayTransitioning[i] = false;
      } 
      else {
        // In transition - show intermediate state (optional)
        // Rapid blink during transition
        if ((millis() / 50) % 2 == 0) {
          digitalWrite(RELAY_PINS[i], HIGH);
        } else {
          digitalWrite(RELAY_PINS[i], LOW);
        }
      }
    }
  }
}

// ===== TEST FUNCTIONS (Optional) =====
// Call this from setup() for a self-test sequence
void runSelfTest() {
  Serial.println("Self-test starting...");
  
  // Test each relay individually
  for (int i = 0; i < NUM_RELAYS; i++) {
    relayState = 1 << i;
    for (int j = 0; j < NUM_RELAYS; j++) {
      digitalWrite(RELAY_PINS[j], bitRead(relayState, j));
    }
    Serial.print("Relay ");
    Serial.println(i + 1);
    delay(300);
  }
  
  // All on
  relayState = 0xFF;
  for (int j = 0; j < NUM_RELAYS; j++) {
    digitalWrite(RELAY_PINS[j], HIGH);
  }
  Serial.println("All ON");
  delay(500);
  
  // All off
  relayState = 0x00;
  for (int j = 0; j < NUM_RELAYS; j++) {
    digitalWrite(RELAY_PINS[j], LOW);
  }
  Serial.println("All OFF");
  delay(500);
  
  Serial.println("Self-test complete.");
}